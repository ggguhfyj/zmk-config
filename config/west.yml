## config/west.yml
```yaml
manifest:
  defaults:
    revision: v0.3
  remotes:
    - name: zmkfirmware
      url-base: https://github.com/zmkfirmware
    - name: badjeff
      url-base: https://github.com/badjeff
  projects:
    - name: zmk
      remote: zmkfirmware
      import: app/west.yml
    - name: zmk-pmw3610-driver
      remote: badjeff
      revision: zmk-0.3
    - name: zmk-keyboards-charybdis
      url: https://github.com/victorlucachi/zmk-keyboards-charybdis
      revision: main
      path: modules/zmk-keyboards-charybdis
  self:
    path: config
```

## modules/zmk-keyboards-charybdis/boards/shields/charybdis/Kconfig
```kconfig
menu "Charybdis shield configuration"

config PMW3610_REST1_DOWNSHIFT_TIME_MS
    int
    default 3000
    help
      PMW3610 REST1 downshift time in milliseconds.

config PMW3610_REST2_DOWNSHIFT_TIME_MS
    int
    default 30000
    help
      PMW3610 REST2 downshift time in milliseconds.

endmenu
```
